## conf/layer.conf
```bitbake
# We have a conf and classes directory, add to BBPATH
BBPATH .= ":${LAYERDIR}"

# We have recipes-* directories, add to BBFILES
BBFILES += "${LAYERDIR}/recipes-*/*/*.bb \
            ${LAYERDIR}/recipes-*/*/*.bbappend"

BBFILE_COLLECTIONS += "skarnet"
BBFILE_PATTERN_skarnet = "^${LAYERDIR}/"
BBFILE_PRIORITY_skarnet = "6"

LAYERDEPENDS_skarnet = "core"
LAYERSERIES_COMPAT_skarnet = "styhead"
```
